## config/west.yml
```yaml
manifest:
  remotes:
    - name: zmkfirmware
      url-base: https://github.com/zmkfirmware
    - name: petejohanson
      url-base: https://github.com/petejohanson
    - name: bobobo1618
      url-base: https://github.com/bobobo1618
  projects:
    - name: zmk
      remote: petejohanson
      revision: feat/pointers-move-scroll
      import: app/west.yml
    - name: cirque-input-module
      remote: petejohanson
      revision: main
    - name: miryoku_zmk
      remote: bobobo1618
      revision: solderless
  self:
    path: config
```
